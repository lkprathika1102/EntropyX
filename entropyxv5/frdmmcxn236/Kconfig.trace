## entropyxv5/frdmmcxn236/Kconfig.trace
```kconfig
config CUSTOM_APP_HELLO_WORLD
    bool
    default y
    select MCUX_PRJSEG_config.arm.warn_as_error
    select MCUX_PRJSEG_config.arm.shared
    select MCUX_PRJSEG_config.mcx.shared
    select MCUX_PRJSEG_config.device_core.define
    select MCUX_PRJSEG_config.arm.core.fpu.fpv5_sp
    select MCUX_PRJSEG_config.arm.core.cm33
    select MCUX_COMPONENT_CMSIS_Include_core_cm
    select MCUX_PRJSEG_module.device.suite
```
